## CMakeLists.txt
```
cmake_minimum_required(VERSION 3.20.0)

project(server)

set(Python3_EXECUTABLE "/usr/bin/python3" CACHE STRING "" FORCE)
find_package(Zephyr REQUIRED HINTS $ENV{ZEPHYR_BASE})

# Xtensa only: linker relaxation for call8 (not used on RISC-V e.g. ESP32-C3)
if(CMAKE_C_COMPILER MATCHES "xtensa-")
  zephyr_ld_options(-Wl,--relax -Wl,-mlongcalls)
  add_compile_options(-mlongcalls)
endif()

# Use amalgamated open62541 (single .c file for better linking)
target_sources(app PRIVATE src/main.c src/open62541.c)
target_include_directories(app PRIVATE src)
target_compile_definitions(app PRIVATE UA_MINIMAL_CONFIG)
# RISC-V (e.g. ESP32-C3): provide atomic builtins via Zephyr API (no libatomic in SDK)
if(CMAKE_C_COMPILER MATCHES "riscv")
  target_sources(app PRIVATE src/atomic_stub_riscv.c)
endif()

# Optimize for code size
add_compile_options(-Os -fno-asynchronous-unwind-tables -fno-unwind-tables -ffunction-sections -fdata-sections)
```

## west.yml
```
# Minimal manifest so Zephyr CMake finds the manifest file when building from this workspace.
manifest:
  remotes:
    - name: zephyrproject-rtos
      url-base: https://github.com/zephyrproject-rtos

  projects:
    - name: zephyr
      remote: zephyrproject-rtos
      revision: main
```

## prj.conf
```kconfig
# Force linker relaxation (Xtensa call8 range)
CONFIG_LINKER_USE_RELAX=y

# Networking - minimal for OPC UA (reduced to shrink binary / help call8)
CONFIG_NETWORKING=y
CONFIG_NET_DRIVERS=y
CONFIG_NET_SOCKETS=y
CONFIG_NET_IPV4=y
CONFIG_NET_IPV6=n
CONFIG_NET_TCP=y
CONFIG_NET_PKT_RX_COUNT=2
CONFIG_NET_PKT_TX_COUNT=2
CONFIG_NET_MAX_CONTEXTS=2
CONFIG_NET_MAX_CONN=1
CONFIG_NET_TX_STACK_SIZE=1536
CONFIG_NET_RX_STACK_SIZE=1536
CONFIG_NET_SOCKETS_POLL_MAX=2
CONFIG_NET_BUF_RX_COUNT=4
CONFIG_NET_BUF_TX_COUNT=4

CONFIG_MAIN_STACK_SIZE=3072

# Minimal runtime
CONFIG_PRINTK=y
CONFIG_NEWLIB_LIBC=y
CONFIG_POSIX_API=y

# mbedTLS for open62541 encryption
# CONFIG_MBEDTLS=y
```

## boards/esp32.overlay
```dts
/ {
    aliases {
        led0 = &blue_led;
    };
};

&blue_led {
    gpios = <&gpio0 2 GPIO_ACTIVE_HIGH>;
};
```

## src/main.c
```c
#include <zephyr/kernel.h>
#include <zephyr/device.h>
#include <zephyr/drivers/gpio.h>
#include "open62541.h"

int main(int argc, char** argv)
{
    /* Create a server listening on port 4840 (default) */
    UA_Server *server = UA_Server_new();

    /* Add a variable node to the server */

    /* 1) Define the variable attributes */
    UA_VariableAttributes attr = UA_VariableAttributes_default;
    attr.displayName = UA_LOCALIZEDTEXT("en-US", "the answer");
    UA_Int32 myInteger = 42;
    UA_Variant_setScalar(&attr.value, &myInteger, &UA_TYPES[UA_TYPES_INT32]);

    /* 2) Define where the node shall be added with which browsename */
    UA_NodeId newNodeId = UA_NODEID_STRING(1, "the.answer");
    UA_NodeId parentNodeId = UA_NS0ID(OBJECTSFOLDER);
    UA_NodeId parentReferenceNodeId = UA_NS0ID(ORGANIZES);
    UA_NodeId variableType = UA_NODEID_NULL; /* take the default variable type */
    UA_QualifiedName browseName = UA_QUALIFIEDNAME(1, "the answer");

    /* 3) Add the node */
    UA_Server_addVariableNode(server, newNodeId, parentNodeId,
                              parentReferenceNodeId, browseName,
                              variableType, attr, NULL, NULL);

    /* Run the server (until ctrl-c interrupt) */
    UA_StatusCode status = UA_Server_runUntilInterrupt(server);

    /* Clean up */
    UA_Server_delete(server);
    return status == UA_STATUSCODE_GOOD ? EXIT_SUCCESS : EXIT_FAILURE;
}
```

## src/atomic_stub_riscv.c
```c
/*
 * Stub implementations of GCC atomic builtins for RISC-V (e.g. ESP32-C3)
 * when libatomic is not available in the toolchain. Uses Zephyr's atomic API.
 * Only linked when building for RISC-V (see CMakeLists.txt).
 */
#include <zephyr/kernel.h>
#include <stdbool.h>
#include <stdint.h>

/* GCC libatomic ABI: 4-byte compare-and-exchange */
bool __atomic_compare_exchange_4(void *ptr, void *expected, uint32_t desired,
				 int weak, int success_memorder, int failure_memorder)
{
	(void)weak;
	(void)success_memorder;
	(void)failure_memorder;
	uint32_t exp = *(uint32_t *)expected;
	bool ok = atomic_cas((atomic_t *)ptr, (atomic_val_t)exp, (atomic_val_t)desired);
	if (!ok)
		*(uint32_t *)expected = (uint32_t)atomic_get((atomic_t *)ptr);
	return ok;
}

/* GCC libatomic ABI: 4-byte exchange */
uint32_t __atomic_exchange_4(void *ptr, uint32_t val, int memorder)
{
	(void)memorder;
	return (uint32_t)atomic_set((atomic_t *)ptr, (atomic_val_t)val);
}
```
